## build-chip/conf/bblayers.conf
```bitbake
# LAYER_CONF_VERSION is increased each time build/conf/bblayers.conf
# changes incompatibly
LCONF_VERSION = "6"

BBPATH = "${TOPDIR}"
BBFILES ?= ""

BBLAYERS ?= " \
  /builds/iichip/poky/meta \
  /builds/iichip/poky/meta-yocto \
  /builds/iichip/poky/meta-yocto-bsp \
  /builds/iichip/poky/meta-chip \
  "
BBLAYERS_NON_REMOVABLE ?= " \
  /builds/iichip/poky/meta \
  /builds/iichip/poky/meta-yocto \
  "
```
